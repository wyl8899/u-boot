## board/neptunus/neptunus/Kconfig
```kconfig
if TARGET_NEPTUNUS

config SYS_BOARD
	default "neptunus"

config SYS_VENDOR
	default "neptunus"

config SYS_CONFIG_NAME
	default "neptunus"

config SYS_TEXT_BASE
	default 0xbe000000

endif
```

## configs/neptunus_defconfig
```kconfig
CONFIG_TARGET_NEPTUNUS=y

CONFIG_MIPS=y
CONFIG_SYS_LITTLE_ENDIAN=y

# cache is not implemented
CONFIG_SYS_MIPS_CACHE_MODE=2

CONFIG_OF_CONTROL=y
CONFIG_OF_SEPARATE=y

CONFIG_DM=y
CONFIG_DM_SERIAL=y
CONFIG_NEPTUNUS_SERIAL=y

CONFIG_LIB_RAND=y

# CONFIG_MIPS_BOOT_ENV_LEGACY is not set
CONFIG_MIPS_BOOT_FDT=y
CONFIG_DEFAULT_DEVICE_TREE="neptunus"
# CONFIG_BOOTDELAY=5
# CONFIG_DISPLAY_BOARDINFO is not set
# CONFIG_HUSH_PARSER=y
CONFIG_SYS_PROMPT="Neptunus # "
# CONFIG_CMD_IMLS is not set
# CONFIG_CMD_SAVEENV is not set
CONFIG_CMD_MEMINFO=y
# CONFIG_CMD_FLASH is not set
# CONFIG_CMD_FPGA is not set
# CONFIG_CMD_DHCP=y
# CONFIG_CMD_MII=y
# CONFIG_CMD_PING=y
# CONFIG_CMD_TIME=y
# CONFIG_OF_EMBED=y
# CONFIG_NET_RANDOM_ETHADDR=y
# CONFIG_NETCONSOLE=y
# CONFIG_CLK=y
# CONFIG_XILINX_EMACLITE=y
# CONFIG_SYS_NS16550=y
# CONFIG_CMD_DHRYSTONE=y
```
